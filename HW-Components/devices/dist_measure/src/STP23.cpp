/**
 *******************************************************************************
 * @file      : STP23.cpp
 * @brief     : 单点激光测距模块 STP23
 * @history   :
 *  Version     Date            Author          Note
 *  V0.9.0      2025-02-12      Jinletian       1.Create this file
 *******************************************************************************
 * @attention :
 * 1. STP23 单点激光测距模块依赖 uart 口 5V 供电，使用时请确保供电正常，例如：达妙 h7
 *    控制板需要配置 PC15 口推挽输出模式，并置为高电平。
 * 2. 该类依赖串口接收管理器 UartRxMgr，使用前请确保 UartRxMgr 按要求配置于初始化，其中
 *    串口波特率设置为 921600 bps，字长 8 Bits(include Parity)，无校验，停止位 1，只接收。
 *    串口接收管理器中 buf_len 设置为 STP::kRxDataLen + 1，max_process_data_len 设置为
 *    STP::kRxDataLen，eof_type 设置为 EofType::kIdle
 *******************************************************************************
 *  Copyright (c) 2025 Hello World Team,Zhejiang University.
 *  All Rights Reserved.
 *******************************************************************************
 */
/* Includes ------------------------------------------------------------------*/
#include "STP23.hpp"

#include <cstring>

namespace hello_world
{
namespace dist_measure
{
/* Private macro -------------------------------------------------------------*/
/* Private constants ---------------------------------------------------------*/

/* 用于 CRC8 校验的数组 */
static const uint8_t CrcTable[256] = {
    0x00, 0x4d, 0x9a, 0xd7, 0x79, 0x34, 0xe3,
    0xae, 0xf2, 0xbf, 0x68, 0x25, 0x8b, 0xc6, 0x11, 0x5c, 0xa9, 0xe4, 0x33,
    0x7e, 0xd0, 0x9d, 0x4a, 0x07, 0x5b, 0x16, 0xc1, 0x8c, 0x22, 0x6f, 0xb8,
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    0x5a, 0x06, 0x4b, 0x9c, 0xd1, 0x7f, 0x32, 0xe5, 0xa8};

/* Private types -------------------------------------------------------------*/
/* Private variables ---------------------------------------------------------*/
/* External variables --------------------------------------------------------*/
/* Exported function definitions ---------------------------------------------*/
/* Private function prototypes -----------------------------------------------*/

bool STP23::decode(size_t len, const uint8_t *data, uint32_t rx_id)
{
  if (len != kRxDataLen) {
    decode_fail_cnt_++;
    return false;
  }

  memcpy(&data_, data, len);

  // 帧头校验
  if (data_.header != 0x54) {
    decode_fail_cnt_++;
    return false;
  }

  // CRC 校验
  crc_ = 0;
  for (uint8_t i = 0; i < kRxDataLen - 1; i++) {
    crc_ = CrcTable[(crc_ ^ data[i]) & 0xff];
  }
  if (crc_ != data_.crc8) {
    decode_fail_cnt_++;
    crc_fail_cnt_++;
    return false;
  }

  calcDistance();
  decode_success_cnt_++;
  oc_.update();
  is_updated_ = true;

  return true;
}

void STP23::calcDistance(void)
{
  float dist_sum = 0;
  float current_dist = 0;
  uint8_t dist_count = 0;

  for (int i = 0; i < 12; i++)  // 12个点取平均
  {
    if (data_.point[i].distance != 0)  // 去除0的点
    {
      dist_count++;
      dist_sum += data_.point[i].distance;
    }
  }
  if (dist_count != 0) {
    current_dist = dist_sum / dist_count;
  } else {
    current_dist = 0;
  }

  // 低通滤波
  distance_ = (1 - weight_) * distance_ + weight_ * current_dist;
}
}  // namespace dist_measure
}  // namespace hello_world